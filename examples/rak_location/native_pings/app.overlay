#include "../controller_test/app.overlay"

&tag_app { reg = <0x26000 0x93000>; };
&flash0 {
  partitions {
    /delete-node/ partition@c1000;
    storage_partition: partition@b9000 { label = "native-ping-settings"; reg = <0xb9000 0x8000>; };
  };
};
