## examples/rak_location/native_pings/Kconfig
```kconfig
rsource "../../rak_sidewalk/Kconfig.proximity"
source "$(ZEPHYR_BASE)/../nrf/samples/bluetooth/fast_pair/locator_tag/Kconfig"
```

## examples/rak_sidewalk/Kconfig
```kconfig
mainmenu "RAK Sidewalk tracker"

rsource "Kconfig.proximity"

source "Kconfig.zephyr"
```

## examples/rak_sidewalk/Kconfig.proximity
```kconfig
config RAK_SIDEWALK_PROXIMITY
    bool "Use native Sidewalk presence beacons without application connection or location requests"
    help
      Run the Sidewalk BLE stack and process its events. Gateway location
      uploads and application-initiated connections are disabled in this image.
```
